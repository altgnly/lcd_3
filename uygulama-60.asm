	LIST P=16F877A
	#INCLUDE <P16F877A.INC>
	SAYICI1 EQU 0X20
	SAYICI2 EQU 0X21
	LCD_DEGER EQU 0X22
	INDIS1 EQU 0X23
	INDIS2 EQU 0X24

	ORG 0X000
	GOTO ANA_METOT

ANA_METOT
	BANKSEL TRISB
	CLRF TRISB
	BANKSEL PORTB
	CLRF PORTB

	CLRF INDIS1
	CLRF INDIS2

	CALL SET_DISPLAY

KONUM1
	MOVLW 0X85
	CALL KOMUT_YAZ
	
ISIM
	MOVF INDIS1,W
	CALL TABLO1
	XORLW 0X00
	BTFSC STATUS,Z
	GOTO KONUM2
	CALL VERI_YAZ
	INCF INDIS1,F
	GOTO ISIM

	RETURN

KONUM2
	MOVLW 0XC5
	CALL KOMUT_YAZ

SOYISIM
	MOVF INDIS2,W	
	CALL TABLO2
	XORLW 0X00
	BTFSC STATUS,Z
	GOTO DONGU
	CALL VERI_YAZ
	INCF INDIS2,F
	GOTO SOYISIM

	RETURN

SET_DISPLAY
	MOVLW H'02'			;ÝMLEÇ 1.SATIR 1.SÜTUN KONUMUNDADIR.
	CALL KOMUT_YAZ

	MOVLW H'06'			;VERÝ YAZILIR, ÝMLEÇ BÝR SAÐA KONUMLANDIRILIR.
	CALL KOMUT_YAZ

	MOVLW H'0C'
	CALL KOMUT_YAZ

	MOVLW H'28'
	CALL KOMUT_YAZ

	RETURN

KOMUT_YAZ
	MOVWF LCD_DEGER
	SWAPF LCD_DEGER,W
	ANDLW 0X0F
	MOVWF PORTB
	BCF PORTB,4
	BSF PORTB,5
;	CALL GECIKME
	BCF PORTB,5

	MOVF LCD_DEGER,W
	ANDLW 0X0F
	MOVWF PORTB
	BCF PORTB,4
	BSF PORTB,5
;	CALL GECIKME
	BCF PORTB,5
	RETURN

VERI_YAZ
	MOVWF LCD_DEGER
	SWAPF LCD_DEGER,W
	ANDLW 0X0F
	MOVWF PORTB
	BSF PORTB,4
	BSF PORTB,5
;	CALL GECIKME
	BCF PORTB,5

	MOVF LCD_DEGER,W
	ANDLW 0X0F
	MOVWF PORTB
	BSF PORTB,4
	BSF PORTB,5
;	CALL GECIKME
	BCF PORTB,5
	RETURN

TABLO1
	ADDWF PCL,F
	RETLW 'N'
	RETLW 'I'
	RETLW 'L'
	RETLW 'A'
	RETLW 'Y'
	RETLW 0X00

TABLO2
	ADDWF PCL,F
	RETLW 'A'
	RETLW 'L'
	RETLW 'T'
	RETLW 'U'
	RETLW 'G'
	RETLW 0X00

;GECIKME
;	MOVLW D'60'
;	MOVWF SAYICI1

;TEKRAR1
;	MOVLW D'130'
;	MOVWF SAYICI2

;TEKRAR2
;	DECFSZ SAYICI2,F
;	GOTO TEKRAR2
;	DECFSZ SAYICI1,F
;	GOTO TEKRAR1
;	RETURN

DONGU
	GOTO DONGU

END